## dom/sdkconfig.defaults
```kconfig
# Enable I2C driver
CONFIG_I2C_ENABLE=y

# Set ESP32 log levels to INFO by default
CONFIG_LOG_DEFAULT_LEVEL_INFO=y

# Enable FreeRTOS stats formatting functions
CONFIG_FREERTOS_USE_TRACE_FACILITY=y
CONFIG_FREERTOS_USE_STATS_FORMATTING_FUNCTIONS=y

# Set GPIO pin configuration for I2C
CONFIG_GPIO8_PULL_UP=y
CONFIG_GPIO9_PULL_UP=y
```

## sub/sdkconfig.defaults
```kconfig
CONFIG_ESPTOOLPY_FLASHSIZE_4MB=y
CONFIG_ESP_TASK_WDT_TIMEOUT_S=10
CONFIG_ESP_MAIN_TASK_STACK_SIZE=7168
CONFIG_FREERTOS_HZ=1000
CONFIG_ESP_WIFI_STATIC_RX_BUFFER_NUM=16
CONFIG_ESP_WIFI_DYNAMIC_RX_BUFFER_NUM=64
CONFIG_ESP_WIFI_RX_BA_WIN=16
CONFIG_LWIP_TCP_SND_BUF_DEFAULT=65535
CONFIG_LWIP_TCP_WND_DEFAULT=65535
CONFIG_LWIP_TCP_RECVMBOX_SIZE=64
CONFIG_OPTIMIZATION_LEVEL_RELEASE=y
```
